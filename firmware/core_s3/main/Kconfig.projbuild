## firmware/core_s3/main/Kconfig.projbuild
```kconfig
menu "Project Luma"

config USE_CUSTOM_WAKE_WORD
    bool "Enable local custom wake word"
    default n
    help
        Disabled in the lean CoreS3 build. Touch wake remains available.

config CUSTOM_WAKE_WORD
    string "Custom wake word"
    depends on USE_CUSTOM_WAKE_WORD
    default "ni hao lu ma"

config CUSTOM_WAKE_WORD_DISPLAY
    string "Custom wake word display text"
    depends on USE_CUSTOM_WAKE_WORD
    default "你好 Luma"

config CUSTOM_WAKE_WORD_THRESHOLD
    int "Custom wake word threshold percent"
    depends on USE_CUSTOM_WAKE_WORD
    range 1 100
    default 20

endmenu
```
